#include "OtaProcessor.h"

#ifdef __cplusplus
extern "C" {
#endif

#include "flash_api.h"
#include "sys_api.h"

#ifdef __cplusplus
}
#endif

const uint8_t example_data[] = {
    0x54, 0x58, 0x54, 0x20, 0x74, 0x65, 0x73, 0x74, 0x20, 0x66, 0x69, 0x6c, 0x65, 0x0a, 0x50, 0x75,
    0x72, 0x70, 0x6f, 0x73, 0x65, 0x3a, 0x20, 0x50, 0x72, 0x6f, 0x76, 0x69, 0x64, 0x65, 0x20, 0x65,
    0x78, 0x61, 0x6d, 0x70, 0x6c, 0x65, 0x20, 0x6f, 0x66, 0x20, 0x74, 0x68, 0x69, 0x73, 0x20, 0x66,
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    0x6c, 0x69, 0x63, 0x65, 0x6e, 0x73, 0x65, 0x20, 0x61, 0x62, 0x6f, 0x76, 0x65, 0x2e,
};

char* firmwareSignPubKey =
    "-----BEGIN CERTIFICATE-----\n"
    "MIIBdjCCAR2gAwIBAgIJAJehK77gCF87MAoGCCqGSM49BAMCMC4xLDAqBgNVBAMM\n"
    "I2RlcWluZy5zdW5Ac21hcnRkZXNpZ253b3JsZHdpZGUuY29tMB4XDTI1MDQzMDA1\n"
    "MzUzNFoXDTI2MDQzMDA1MzUzNFowLjEsMCoGA1UEAwwjZGVxaW5nLnN1bkBzbWFy\n"
    "dGRlc2lnbndvcmxkd2lkZS5jb20wWTATBgcqhkjOPQIBBggqhkjOPQMBBwNCAARp\n"
    "3earZ14OqZigRBHKP3KQ5G1afiwWHFYJHNsutZ0BSU6b6rIoJQQKr/S/lt1wrheJ\n"
    "U9EOOLzq023NSjYqmTbBoyQwIjALBgNVHQ8EBAMCB4AwEwYDVR0lBAwwCgYIKwYB\n"
    "BQUHAwMwCgYIKoZIzj0EAwIDRwAwRAIgJjKIaqOukQlVQMSRihgAsTZ2dKcH5qKb\n"
    "+ClvfUUNKRYCIBExWYBNwZCzCGpKQ1V/qilbeiZeG/VBE8EEXCi7XR9N\n"
    "-----END CERTIFICATE-----\n"; 

char* sampleSignature = "MEYCIQClLGxvGlVlljtlmrHc+LkKz2hyNKaE7jDHuQYhoYkBmAIhANdZpypAQ09n2VMKtNg89HlAmYOUonW4q6BVsWtxor+S";

OtaProcessor otaProcessor;

void setup() {
  delay(550);
  Serial.begin(115200);
  // put your setup code here, to run once:
  pinMode(PB3, OUTPUT);
  pinMode(PA14, OUTPUT);
  pinMode(PA13, OUTPUT);

  digitalWrite(PB3, HIGH);
  digitalWrite(PA14, HIGH);
  digitalWrite(PA13, HIGH);

  //digitalWrite(6, LOW);
}

void loop() {
  delay(100);
  //digitalWrite(PB3, LOW);
  //digitalWrite(6, LOW);
  GPIO_WriteBit(0x23, 0);
  delay(100);
  //digitalWrite(PB3, HIGH);
  //digitalWrite(6, HIGH);
  GPIO_WriteBit(0x23, 1);

  //Serial.print("Dynamic memory size1: ");
  //Serial.println(os_get_free_heap_size_arduino());

  int flashSize = OtaProcessor::checkFlashSize();
  if (flashSize != 4*1024*1024) {
    while (1) {
      Serial.println("Flash size is not 4MB");
      delay(1000);
    }
  }
  int img2Address = OtaProcessor::checkImg2AddressInBootloader();
  if (img2Address < 0x08200000) {
    while (1) {
      Serial.print("img2Address is now ");
      Serial.println(img2Address, HEX);
      Serial.println("It is likely you are using a bootloader for 2MB flash chips");
      Serial.println("Please use the bootloader for 4MB flash chips as we need to do OTA");
      Serial.println("Please modify OTA_Region through source code or binary modification");
      //dump the bootloader to packages/realtek/tools/ameba_d_tools/1.1.3/bsp/image/PMU_bins/NONE
      delay(1000);
    }
  }
  int imgNumber = OtaProcessor::getCurrentImgNumber();
  Serial.print("Current image number is ");
  Serial.println(imgNumber);





  otaProcessor.initCodeSigningCert((char *)firmwareSignPubKey);

  // Serial.print("Dynamic memory size2: ");
  // Serial.println(os_get_free_heap_size_arduino());


                // if (mbedtls_x509_crt_parse(cacert, rootCABuff, (strlen((char*)rootCABuff)) + 1) != 0) {
                //     printf("ERROR: mbedtls x509 crt parse failed! \r\n");
                //     ret = -1;
                //     break;
                // }



  otaProcessor.OtaProcessInit();
  for (int offset = 0; offset < (int)sizeof(example_data); offset+=2048) 
  {
    int len = sizeof(example_data) - offset;
    if (len > 2048) len = 2048;
    otaProcessor.OtaProcessDataChunk((uint8_t*)example_data + offset, len, offset);
  }

  // Serial.print("Dynamic memory size3: ");
  // Serial.println(os_get_free_heap_size_arduino());

  otaProcessor.OtaProcessVerifySignature(sampleSignature);


  Serial.print("millis ");
  Serial.println(millis());

  if ((millis()>15000) && (imgNumber!=2)){

#define OTA_ADDRESS_1 0x6000
#define OTA_ADDRESS_2 0x206000

      int blocksToCopyFromOta1ToOta2 = 100;
      int sameBlocksCount = 0;
      int differentBlocksCount = 0;
      for (int i = 0; i < blocksToCopyFromOta1ToOta2; i++) {
          uint8_t *ota1Ptr = (uint8_t *)(0x08000000 + OTA_ADDRESS_1 + i * 4096);
          uint8_t *ota2Ptr = (uint8_t *)(0x08000000 + OTA_ADDRESS_2 + i * 4096);
          int theBlockIsSame = 1;
          for (int j = 0; j < 4096; j++) {
          if (*ota1Ptr++ != *ota2Ptr++) {
              theBlockIsSame = 0;
              break;
          }
          }
          if (theBlockIsSame) {
          sameBlocksCount++;
          } else {
          differentBlocksCount++;
          }
      }

      Serial.print("Same blocks count: ");
      Serial.println(sameBlocksCount);
      Serial.print("Different blocks count: ");
      Serial.println(differentBlocksCount);

      Serial.println("Copying blocks from OTA 1 to OTA 2");
      for (int i = 0; i < blocksToCopyFromOta1ToOta2; i++) {
          uint8_t *ota1Ptr = (uint8_t *)(0x08000000 + OTA_ADDRESS_1 + i * 4096);
          uint8_t *ota2Ptr = (uint8_t *)(0x08000000 + OTA_ADDRESS_2 + i * 4096);
          int theBlockIsSame = 1;
          for (int j = 0; j < 4096; j++) {
          if (*ota1Ptr++ != *ota2Ptr++) {
              theBlockIsSame = 0;
              break;
          }
          }
          if (theBlockIsSame) {
          } else {
          Serial.print("Copying block ");
          Serial.print(i);
          Serial.println(" from OTA 1 to OTA 2");
          uint8_t swapData[4096];
          flash_erase_sector(NULL, OTA_ADDRESS_2 + i * 4096);
          flash_stream_read(NULL, OTA_ADDRESS_1 + i * 4096, 4096, swapData);
          flash_stream_write(NULL, OTA_ADDRESS_2 + i * 4096, 4096, swapData);
          }
      }

      for (int i = 0; i < 5; i++) {
          delay(1000);
          Serial.print("REBOOT ");
          Serial.println(i);
      }

      sys_reset();
  }

  delay(1000);

  

}
