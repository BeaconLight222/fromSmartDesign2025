#include "Arduino.h"
#include <sockets.h> 
#include <lwip/netif.h>
#include <mbedtls/ssl.h>
#include <mbedtls/net_sockets.h>
#include <mbedtls/error.h>
#include <mbedtls/debug.h>
#include "ard_ssl.h"


//cacert_raw_p seems to have to be in ram
//tag 0, length 837
unsigned char cacert_raw_p[837] = {
0x30, 0x82, 0x03, 0x41, 0x30, 0x82, 0x02, 0x29, 0xA0, 0x03, 0x02, 0x01, 0x02, 0x02, 0x13, 0x06, 0x6C, 0x9F, 0xCF, 0x99, 0xBF, 0x8C, 0x0A, 0x39, 0xE2, 0xF0, 0x78, 0x8A, 0x43, 0xE6, 0x96, 0x36, 
0x5B, 0xCA, 0x30, 0x0D, 0x06, 0x09, 0x2A, 0x86, 0x48, 0x86, 0xF7, 0x0D, 0x01, 0x01, 0x0B, 0x05, 0x00, 0x30, 0x39, 0x31, 0x0B, 0x30, 0x09, 0x06, 0x03, 0x55, 0x04, 0x06, 0x13, 0x02, 0x55, 0x53, 
0x31, 0x0F, 0x30, 0x0D, 0x06, 0x03, 0x55, 0x04, 0x0A, 0x13, 0x06, 0x41, 0x6D, 0x61, 0x7A, 0x6F, 0x6E, 0x31, 0x19, 0x30, 0x17, 0x06, 0x03, 0x55, 0x04, 0x03, 0x13, 0x10, 0x41, 0x6D, 0x61, 0x7A, 
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0xC4, 0x90, 0xBE, 0xF1, 0xB9
};

//tag 0, length 557
const unsigned char cacert_tbs_p[557] = {
0x30, 0x82, 0x02, 0x29, 0xA0, 0x03, 0x02, 0x01, 0x02, 0x02, 0x13, 0x06, 0x6C, 0x9F, 0xCF, 0x99, 0xBF, 0x8C, 0x0A, 0x39, 0xE2, 0xF0, 0x78, 0x8A, 0x43, 0xE6, 0x96, 0x36, 0x5B, 0xCA, 0x30, 0x0D, 
0x06, 0x09, 0x2A, 0x86, 0x48, 0x86, 0xF7, 0x0D, 0x01, 0x01, 0x0B, 0x05, 0x00, 0x30, 0x39, 0x31, 0x0B, 0x30, 0x09, 0x06, 0x03, 0x55, 0x04, 0x06, 0x13, 0x02, 0x55, 0x53, 0x31, 0x0F, 0x30, 0x0D, 
0x06, 0x03, 0x55, 0x04, 0x0A, 0x13, 0x06, 0x41, 0x6D, 0x61, 0x7A, 0x6F, 0x6E, 0x31, 0x19, 0x30, 0x17, 0x06, 0x03, 0x55, 0x04, 0x03, 0x13, 0x10, 0x41, 0x6D, 0x61, 0x7A, 0x6F, 0x6E, 0x20, 0x52, 
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0x0C, 0x94, 0x94, 0x2E, 0x08, 0x59, 0x9C, 0xC7, 0xB2, 0x10, 0x4E, 0x0A, 0x08
};
//version: 3

//tag 2, length 19
const unsigned char cacert_serial_p[19] = {
0x06, 0x6C, 0x9F, 0xCF, 0x99, 0xBF, 0x8C, 0x0A, 0x39, 0xE2, 0xF0, 0x78, 0x8A, 0x43, 0xE6, 0x96, 0x36, 0x5B, 0xCA
};
//tag 6, length 9
const unsigned char cacert_sig_oid_p[9] = {
0x2A, 0x86, 0x48, 0x86, 0xF7, 0x0D, 0x01, 0x01, 0x0B
};
//tag 0, length 59
const unsigned char cacert_issuer_raw_p[59] = {
0x30, 0x39, 0x31, 0x0B, 0x30, 0x09, 0x06, 0x03, 0x55, 0x04, 0x06, 0x13, 0x02, 0x55, 0x53, 0x31, 0x0F, 0x30, 0x0D, 0x06, 0x03, 0x55, 0x04, 0x0A, 0x13, 0x06, 0x41, 0x6D, 0x61, 0x7A, 0x6F, 0x6E, 
0x31, 0x19, 0x30, 0x17, 0x06, 0x03, 0x55, 0x04, 0x03, 0x13, 0x10, 0x41, 0x6D, 0x61, 0x7A, 0x6F, 0x6E, 0x20, 0x52, 0x6F, 0x6F, 0x74, 0x20, 0x43, 0x41, 0x20, 0x31
};
//tag 0, length 59
const unsigned char cacert_subject_raw_p[59] = {
0x30, 0x39, 0x31, 0x0B, 0x30, 0x09, 0x06, 0x03, 0x55, 0x04, 0x06, 0x13, 0x02, 0x55, 0x53, 0x31, 0x0F, 0x30, 0x0D, 0x06, 0x03, 0x55, 0x04, 0x0A, 0x13, 0x06, 0x41, 0x6D, 0x61, 0x7A, 0x6F, 0x6E, 
0x31, 0x19, 0x30, 0x17, 0x06, 0x03, 0x55, 0x04, 0x03, 0x13, 0x10, 0x41, 0x6D, 0x61, 0x7A, 0x6F, 0x6E, 0x20, 0x52, 0x6F, 0x6F, 0x74, 0x20, 0x43, 0x41, 0x20, 0x31
};

const unsigned char cacert_subject_country_oid[3] = {0x55, 0x04, 0x06};
const unsigned char cacert_subject_country_value[] = {"US"};
const unsigned char cacert_subject_organization_oid[3] = {0x55, 0x04, 0x0A};
const unsigned char cacert_subject_organization_value[] = {"Amazon"};
const unsigned char cacert_subject_common_name_oid[3] = {0x55, 0x04, 0x03};
const unsigned char cacert_subject_common_name_value[] = {"Amazon Root CA 1"};

//if it is const, we get hard fault...
struct mbedtls_asn1_named_data cacert_subject_common_name = {
    .oid = {
        .tag = MBEDTLS_ASN1_OID,
        .len = 3,
        .p = (unsigned char *)cacert_subject_common_name_oid
    },
    .val = {
        .tag = MBEDTLS_ASN1_PRINTABLE_STRING,
        .len = 16,
        .p = (unsigned char *)cacert_subject_common_name_value
    },
    .next = NULL
};
struct mbedtls_asn1_named_data cacert_subject_organization = {
    .oid = {
        .tag = MBEDTLS_ASN1_OID,
        .len = 3,
        .p = (unsigned char *)cacert_subject_organization_oid
    },
    .val = {
        .tag = MBEDTLS_ASN1_PRINTABLE_STRING,
        .len = 6,
        .p = (unsigned char *)cacert_subject_organization_value
    },
    .next = &cacert_subject_common_name
};

extern const mbedtls_pk_info_t mbedtls_rsa_info;

uint32_t cacert_N_p[64] = {
0x9AC8AA0D, 0x8E04AE6C, 0x3E3B2426, 0x80C4804C, 0x40207F20, 0x8723D63F, 0x67C80F9C, 0x54E177E0, 0x1BC5C71E, 0xDBFB2D62, 0xAE50386F, 0x02CB388A, 0x69FFEA95, 0xF7715C5E, 0x240E2D4B, 0xCAB4F29F, 
0xFAB71DAA, 0x4628B843, 0x8717F232, 0x596EBB73, 0x24F79EC4, 0x7035D788, 0x2D7D2D74, 0xFFD1E830, 0x91F948DC, 0x54EBA3C3, 0xA14566BA, 0xC0308666, 0x6F89A351, 0xEE94785E, 0x48673096, 0xBAD5A9F9, 
0x873958F8, 0x3807DCA2, 0x47198F50, 0xA6F9AFEC, 0x7AD080B2, 0x2050066C, 0x392FFAB0, 0xDA9C9B35, 0xB416FA74, 0x45E1F9FD, 0xE54A56E4, 0xFE8236A5, 0x1D619EA4, 0xD7B97638, 0x4968B0DE, 0xF5B519F8, 
0xC73EEB37, 0xF4EE8823, 0x0717364C, 0x8DDB48C8, 0x36BA01BE, 0x4EB2A4D0, 0xD3A0437A, 0xAC022D86, 0x7484012F, 0x582160F9, 0xF49968F7, 0xD8D78876, 0x50747D6E, 0x71AF4780, 0xCA78D5E3, 0xB2788071
};
uint32_t cacert_E_p[1] = {0x10001};

mbedtls_rsa_context cacert_rsa = {
    .ver = 0,
    .len = 256,
    .N = { .s=1, .n=64,.p = cacert_N_p },
    .E = { .s=1, .n=1, .p = cacert_E_p },
};


#define ARDUINO_MBEDTLS_DEBUG_LEVEL     0   // Set to 0 to disable debug messages, 5 to enable all debug messages

static unsigned int ard_ssl_arc4random(void) {
    unsigned int res = xTaskGetTickCount();
    static unsigned int seed = 0xDEADB00B;

    seed = ((seed & 0x007F00FF) << 7) ^ 
           ((seed & 0x0F80FF00) >> 8) ^ // be sure to stir those low bits
            (res << 13) ^ (res >> 9);    // using the clock too!

    return seed;
}

static void get_random_bytes(void *buf, size_t len) {
    unsigned int ranbuf;
    unsigned int *lp;
    int i, count;
    count = len / sizeof(unsigned int);
    lp = (unsigned int *) buf;

    for (i = 0; i < count; i ++) {
        lp[i] = ard_ssl_arc4random();
        len -= sizeof(unsigned int);
    }

    if (len > 0) {
        ranbuf = ard_ssl_arc4random();
        memcpy(&lp[i], &ranbuf, len);
    }
}

static int my_random(void *p_rng, unsigned char *output, size_t output_len) {
    p_rng = p_rng;
    get_random_bytes(output, output_len);
    return 0;
}

static int my_verify(void *data, mbedtls_x509_crt *crt, int depth, uint32_t *flags) {
    char buf[1024];
    ((void)data);

    mbedtls_x509_crt_info(buf, (sizeof(buf) - 1), "", crt);

    if (ARDUINO_MBEDTLS_DEBUG_LEVEL < 3) {
        return 0;
    }

    printf( "\nVerify requested for (Depth %d):\n", depth );
    printf( "%s", buf );

    if ((*flags) == 0) {
        printf(" This certificate has no flags\n");
    } else {
        mbedtls_x509_crt_verify_info(buf, sizeof( buf ), " ! ", *flags);
        printf("%s\n", buf);
    }

    return 0;
}

static void* my_calloc(size_t nelements, size_t elementSize) {
    size_t size;
    void *ptr = NULL;

    size = nelements * elementSize;
    ptr = pvPortMalloc(size);
//  ptr = malloc(size);

    if (ptr) {
        memset(ptr, 0, size);
    }

    return ptr;
}

static void my_debug(void *ctx, int level, const char *file, int line, const char *str ) {
    const char *p, *basename;

    ctx = ctx;     // Remove unused parameter warning
    // Extract basename from file
    for (p = basename = file; *p != '\0'; p++) {
        if(*p == '/' || *p == '\\') {
            basename = p + 1;
        }
    }

    printf("%s:%04d: |%d| %s", basename, line, level, str);
}
#include "mbedtls/pk.h"
#include "mbedtls/pk_internal.h"
int start_ssl_client(sslclient_context *ssl_client, uint32_t ipAddress, uint32_t port, unsigned char* rootCABuff, unsigned char* cli_cert, unsigned char* cli_key, unsigned char* pskIdent, unsigned char* psKey, char* SNI_hostname) {
    int ret = 0;
    //int timeout;
    int enable = 1;
    int keep_idle = 30;
    mbedtls_x509_crt* cacert = NULL;
    mbedtls_x509_crt* _cli_crt = NULL;
    mbedtls_pk_context* _clikey_rsa = NULL;

    do {
        ssl_client->socket = -1;
        ssl_client->socket = lwip_socket(AF_INET, SOCK_STREAM, IPPROTO_TCP);
        if (ssl_client->socket < 0) {
            printf("ERROR: opening socket failed! \r\n");
            ret = -1;
            break;
        }

        struct sockaddr_in serv_addr;
        memset(&serv_addr, 0, sizeof(serv_addr));
        serv_addr.sin_family = AF_INET;
        serv_addr.sin_addr.s_addr = ipAddress;
        serv_addr.sin_port = htons(port);

        lwip_setsockopt(ssl_client->socket, SOL_SOCKET, SO_KEEPALIVE, &enable, sizeof(enable));
        lwip_setsockopt(ssl_client->socket, IPPROTO_TCP, TCP_KEEPIDLE, &keep_idle, sizeof(keep_idle));
        if (lwip_connect(ssl_client->socket, ((struct sockaddr *)&serv_addr), sizeof(serv_addr)) < 0) {
            lwip_close(ssl_client->socket);
            printf("ERROR: Connect to Server failed! \r\n");
            ret = -1;
            break;
        } else {
        /*
        if (lwip_connect(ssl_client->socket, ((struct sockaddr *)&serv_addr), sizeof(serv_addr)) == 0) {
            timeout = ssl_client->recvTimeout;
            lwip_setsockopt(ssl_client->socket, SOL_SOCKET, SO_RCVTIMEO, &timeout, sizeof(timeout));
            timeout = 30000;
            lwip_setsockopt(ssl_client->socket, SOL_SOCKET, SO_SNDTIMEO, &timeout, sizeof(timeout));
            lwip_setsockopt(ssl_client->socket, IPPROTO_TCP, TCP_NODELAY, &enable, sizeof(enable));
            lwip_setsockopt(ssl_client->socket, SOL_SOCKET, SO_KEEPALIVE, &enable, sizeof(enable));
        } else {
            printf("ERROR: Connect to Server failed!\r\n");
            ret = -1;
            break;
        }
        */

            mbedtls_platform_set_calloc_free(my_calloc,vPortFree);

            ssl_client->ssl = (mbedtls_ssl_context *)malloc(sizeof(mbedtls_ssl_context));
            ssl_client->conf = (mbedtls_ssl_config *)malloc(sizeof(mbedtls_ssl_config));
            if (( ssl_client->ssl == NULL )||( ssl_client->conf == NULL )) {
                printf("ERROR: malloc ssl failed! \r\n");
                ret = -1;
                break;
            }
            mbedtls_ssl_init(ssl_client->ssl);
            mbedtls_ssl_config_init(ssl_client->conf);

            if (ARDUINO_MBEDTLS_DEBUG_LEVEL > 0) {
                mbedtls_ssl_conf_verify(ssl_client->conf, my_verify, NULL);
                mbedtls_ssl_conf_dbg(ssl_client->conf, my_debug, NULL);
                mbedtls_debug_set_threshold(ARDUINO_MBEDTLS_DEBUG_LEVEL);
            }

            if ((mbedtls_ssl_config_defaults(ssl_client->conf, MBEDTLS_SSL_IS_CLIENT, MBEDTLS_SSL_TRANSPORT_STREAM, MBEDTLS_SSL_PRESET_DEFAULT)) != 0) {
                printf("ERROR: mbedtls ssl config defaults failed! \r\n");
                ret = -1;
                break;
            }
            mbedtls_ssl_conf_rng(ssl_client->conf, my_random, NULL);

            if (rootCABuff != NULL) {
                //!!!!!
                //printf("!!!! Using rootCA buffer !!!!\r\n");
                //!!!!!

                // Configure mbedTLS to use certificate authentication method
                cacert = (mbedtls_x509_crt *) mbedtls_calloc( sizeof(mbedtls_x509_crt), 1);
                mbedtls_x509_crt_init(cacert);
                // if (mbedtls_x509_crt_parse(cacert, rootCABuff, (strlen((char*)rootCABuff)) + 1) != 0) {
                //     printf("ERROR: mbedtls x509 crt parse failed! \r\n");
                //     ret = -1;
                //     break;
                // }

                cacert->version = 0;
                memset(&cacert->raw, 0, sizeof(cacert->raw));
                memset(&cacert->tbs, 0, sizeof(cacert->tbs));
                memset(&cacert->serial, 0, sizeof(cacert->serial));
                memset(&cacert->sig_oid, 0, sizeof(cacert->sig_oid));
                memset(&cacert->issuer_raw, 0, sizeof(cacert->issuer_raw));
                memset(&cacert->subject_raw, 0, sizeof(cacert->subject_raw));
                memset(&cacert->issuer, 0, sizeof(cacert->issuer));
                memset(&cacert->subject, 0, sizeof(cacert->subject));    //needed
                memset(&cacert->valid_from, 0, sizeof(cacert->valid_from));
                memset(&cacert->valid_to, 0, sizeof(cacert->valid_to));

                memset(&cacert->pk, 0, sizeof(cacert->pk));

                memset(&cacert->issuer_id, 0, sizeof(cacert->issuer_id));
                memset(&cacert->subject_id, 0, sizeof(cacert->subject_id));
                memset(&cacert->v3_ext, 0, sizeof(cacert->v3_ext));
                memset(&cacert->subject_alt_names, 0, sizeof(cacert->subject_alt_names));

                cacert->ext_types = 0;
                cacert->ca_istrue = 0;
                cacert->max_pathlen = 0;
                cacert->key_usage = 0;
                memset(&cacert->ext_key_usage, 0, sizeof(cacert->ext_key_usage));
                cacert->ns_cert_type = 0;
                memset(&cacert->sig, 0, sizeof(cacert->sig));
                memset(&cacert->sig_md, 0, sizeof(cacert->sig_md));
                memset(&cacert->sig_pk, 0, sizeof(cacert->sig_pk));

                cacert->subject.oid.tag = 6;
                cacert->subject.oid.len = 3;
                cacert->subject.oid.p = (unsigned char *)cacert_subject_country_oid;
                cacert->subject.val.tag = 19; //MBEDTLS_ASN1_PRINTABLE_STRING
                cacert->subject.val.len = 2;
                cacert->subject.val.p = (unsigned char *)cacert_subject_country_value;
                cacert->subject.next = &cacert_subject_organization;

                cacert->ca_istrue = 1;

                cacert->pk.pk_info = &mbedtls_rsa_info; // Set the public key info to RSA
                cacert->pk.pk_ctx = (void *)&cacert_rsa; // Set the public key context to our RSA context
                mbedtls_rsa_context* rsa_ctx = (mbedtls_rsa_context *) cacert->pk.pk_ctx;
                rsa_ctx->N.p = (uint32_t *)cacert_N_p; // Set the N value
                rsa_ctx->E.p = (uint32_t *)cacert_E_p;


                //!!!!


                mbedtls_ssl_conf_ca_chain(ssl_client->conf, cacert, NULL);
                mbedtls_ssl_conf_authmode(ssl_client->conf, MBEDTLS_SSL_VERIFY_REQUIRED);
            } else if (pskIdent != NULL && psKey != NULL) {
                // Configure mbedTLS to use PSK authentication method
                // Check for max length and even number of chars
                uint16_t pskey_char_len = strlen((char*)psKey);
                if (((pskey_char_len % 2) != 0) || (pskey_char_len > 2*MBEDTLS_PSK_MAX_LEN)) {
                    printf("ERROR: TLS PSK not in valid hex format or too long \n");
                    return -1;
                }
                uint16_t psk_len = pskey_char_len/2;
                unsigned char psk[MBEDTLS_PSK_MAX_LEN];
                // Convert PSK from hexadecimal chars to binary
                for (int i = 0; i < pskey_char_len; i = i + 2) {
                    char c = psKey[i];
                    // Convert first 4 bits
                    if (c >= '0' && c <= '9') {
                        c = c - '0';
                    } else if (c >= 'A' && c <= 'F') {
                        c = c - 'A' + 10;
                    } else if (c >= 'a' && c <= 'f') {
                        c = c - 'a' + 10;
                    } else {
                        printf("ERROR: TLS PSK not in valid hex format \n");
                        return -1;
                    }
                    psk[i/2] = c << 4;
                    c = psKey[i+1];
                    // Convert next 4 bits
                    if (c >= '0' && c <= '9') {
                        c = c - '0';
                    } else if (c >= 'A' && c <= 'F') {
                        c = c - 'A' + 10;
                    } else if (c >= 'a' && c <= 'f') {
                        c = c - 'a' + 10;
                    } else {
                        printf("ERROR: TLS PSK not in valid hex format \r\n");
                        return -1;
                    }
                    psk[i/2] |= c;
                }
                if (mbedtls_ssl_conf_psk(ssl_client->conf, psk, psk_len, pskIdent, strlen((char*)pskIdent)) != 0) {
                    printf("ERROR: mbedtls conf psk failed! \r\n");
                }
            } else {
                mbedtls_ssl_conf_authmode(ssl_client->conf, MBEDTLS_SSL_VERIFY_NONE);
            }

            if ((cli_cert != NULL) && (cli_key != NULL)) {
                _cli_crt = (mbedtls_x509_crt *) mbedtls_calloc( sizeof(mbedtls_x509_crt), 1);
                if (_cli_crt == NULL) {
                    printf("ERROR: malloc client_crt failed! \r\n");
                    ret = -1;
                    break;
                }
                mbedtls_x509_crt_init(_cli_crt);

                _clikey_rsa = (mbedtls_pk_context *) mbedtls_calloc( sizeof(mbedtls_pk_context), 1);
                if (_clikey_rsa == NULL) {
                    printf("ERROR: malloc client_rsa failed! \r\n");
                    ret = -1;
                    break;
                }
                mbedtls_pk_init(_clikey_rsa);

                if (mbedtls_x509_crt_parse(_cli_crt, cli_cert, strlen((char*)cli_cert) + 1) != 0) {
                    printf("ERROR: mbedtls x509 parse client_crt failed! \r\n");
                    ret = -1;
                    break;
                }

                if (mbedtls_pk_parse_key(_clikey_rsa, cli_key, strlen((char*)cli_key)+1, NULL, 0) != 0) {
                    printf("ERROR: mbedtls x509 parse client_rsa failed! \r\n");
                    ret = -1;
                    break;
                }
                mbedtls_ssl_conf_own_cert(ssl_client->conf, _cli_crt, _clikey_rsa);
            }

            if ((mbedtls_ssl_setup(ssl_client->ssl, ssl_client->conf)) != 0) {
                printf("ERROR: mbedtls ssl setup failed!\r\n");
                ret = -1;
                break;
            }
            mbedtls_ssl_set_bio(ssl_client->ssl, &ssl_client->socket, mbedtls_net_send, mbedtls_net_recv, NULL);

            mbedtls_ssl_set_hostname(ssl_client->ssl, SNI_hostname);

            ret = mbedtls_ssl_handshake(ssl_client->ssl);
            if (ret < 0) {
                printf("ERROR: mbedtls ssl handshake failed: -0x%04X \r\n", -ret);
                ret = -1;
            } else { 
                if (ARDUINO_MBEDTLS_DEBUG_LEVEL > 0) {
                    printf("mbedTLS SSL handshake success \r\n");
                }
            }
            //mbedtls_debug_set_threshold(ARDUINO_MBEDTLS_DEBUG_LEVEL);
        }
    } while (0);

    if (_clikey_rsa) {
        mbedtls_pk_free(_clikey_rsa);
        mbedtls_free(_clikey_rsa);
        _clikey_rsa = NULL;
    }

    if (_cli_crt) {
        mbedtls_x509_crt_free(_cli_crt);
        mbedtls_free(_cli_crt);
        _cli_crt = NULL;
    }

    if (cacert) {
        mbedtls_x509_crt_free(cacert);
        mbedtls_free(cacert);
        cacert = NULL;
    }

    if (ret < 0) {
        if (ssl_client->socket >= 0) {
            mbedtls_net_free((mbedtls_net_context *)&ssl_client->socket);
            ssl_client->socket = -1;
        }

        if (ssl_client->ssl != NULL) {
            mbedtls_ssl_free(ssl_client->ssl);
            free(ssl_client->ssl);
            ssl_client->ssl = NULL;
        }
        if (ssl_client->conf != NULL) {
            mbedtls_ssl_config_free(ssl_client->conf);
            free(ssl_client->conf);
            ssl_client->conf = NULL;
        }
    }
    return ssl_client->socket;
}

void stop_ssl_socket(sslclient_context *ssl_client) {
    lwip_shutdown(ssl_client->socket, SHUT_RDWR);
    lwip_close(ssl_client->socket);
    //mbedtls_net_free((mbedtls_net_context *)&ssl_client->socket);
    ssl_client->socket = -1;

    if (ssl_client->ssl != NULL) {
        mbedtls_ssl_free(ssl_client->ssl);
        free(ssl_client->ssl);
        ssl_client->ssl = NULL;
    }
    if (ssl_client->conf != NULL) {
        mbedtls_ssl_config_free(ssl_client->conf);
        free(ssl_client->conf);
        ssl_client->conf = NULL;
    }
}

int send_ssl_data(sslclient_context *ssl_client, const uint8_t *data, uint16_t len) {
    int ret = -1;

    if (ssl_client->ssl != NULL) {
        ret = mbedtls_ssl_write(ssl_client->ssl, data, len);
    }

    return ret;
}

int get_ssl_receive(sslclient_context *ssl_client, uint8_t* data, int length, int flag) {
    int ret = 0;
    uint8_t has_backup_recvtimeout = 0;
    int backup_recv_timeout, recv_timeout;
    socklen_t len;

    if (ssl_client->ssl == NULL) {
        return 0;
    }

    if (flag & 0x01) {
        // peek for 10ms
        ret = lwip_getsockopt(ssl_client->socket, SOL_SOCKET, SO_RCVTIMEO, &backup_recv_timeout, &len);
        if (ret >= 0) {
            recv_timeout = 100;
            ret = lwip_setsockopt(ssl_client->socket, SOL_SOCKET, SO_RCVTIMEO, &recv_timeout, sizeof(recv_timeout));
            if (ret >= 0) {
                has_backup_recvtimeout = 1;
            }
        }
    }

    memset(data, 0, length);
    ret = mbedtls_ssl_read(ssl_client->ssl, data, length);

    if ((flag & 0x01) && (has_backup_recvtimeout == 1)) {
        // restore receiving timeout
        lwip_setsockopt(ssl_client->socket, SOL_SOCKET, SO_RCVTIMEO, &backup_recv_timeout, sizeof(recv_timeout));
    }

    return ret;
}

int get_ssl_sock_errno(sslclient_context *ssl_client) {
    int so_error;
    socklen_t len = sizeof(so_error);
    lwip_getsockopt(ssl_client->socket, SOL_SOCKET, SO_ERROR, &so_error, &len);
    return so_error;
}

int get_ssl_bytes_avail(sslclient_context *ssl_client) {
    if (ssl_client->ssl != NULL) {
        return mbedtls_ssl_get_bytes_avail(ssl_client->ssl);
    } else {
        return 0;
    }
}
